## src/Kconfig.projbuild
```kconfig
# Copyright 2021,2022,2023 David SPORN
# ---
# This file is part of 'Weather Central'.
# ---
# 'Weather Central' is free software: you can redistribute it and/or 
# modify it under the terms of the GNU General Public License as published 
# by the Free Software Foundation, either version 3 of the License, or 
# (at your option) any later version.

# 'Weather Central' is distributed in the hope that it will be useful, 
# but WITHOUT ANY WARRANTY; without even the implied warranty of 
# MERCHANTABILITY or FITNESS FOR A PARTICULAR PURPOSE. See the GNU General 
# Public License for more details.

# You should have received a copy of the GNU General Public License along 
# with 'Weather Central'. If not, see <https://www.gnu.org/licenses/>. 

menu "WEATHER CENTRAL"

	config LABEL_DEVICE_NAME
		string "Device Name"
		default "The mighty device"
		help
			This label will be displayed when querying about the device.

	config LABEL_MANUFACTURER_NAME
		string "Manufacturer Name"
		default "A. Nonymous"
		help
			This label will be displayed when querying about the device manufacturer.

	rsource "Kconfig-control-panel-mapping.projbuild"
	rsource "Kconfig-spi-host.projbuild"
	rsource "Kconfig-st7789.projbuild"

endmenu #"WEATHER CENTRAL"
```
